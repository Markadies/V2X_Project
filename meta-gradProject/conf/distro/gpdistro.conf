## meta-gradProject/conf/distro/gpdistro.conf
```bitbake
MAINTAINER = "Abdelrahman <abdelrahmanosama372@gmail.com>"

include conf/distro/poky.conf
DISTRO = "gpdistro"

DISTRO_NAME = "Graduation Project Distro"
DISTRO_VERSION = "1.0"

# change hostname
hostname:pn-base-files = "abdelrahman"
DISTRO_FEATURES:remove = " pci pcmcia ext2 irda nfs ptest 3g"
DISTRO_FEATURES += " wifi"

INIT_MANAGER = "systemd"
```

## meta-gradProject/conf/layer.conf
```bitbake
# We have a conf and classes directory, add to BBPATH
BBPATH .= ":${LAYERDIR}"

# We have recipes-* directories, add to BBFILES
BBFILES += "${LAYERDIR}/recipes-*/*/*.bb \
            ${LAYERDIR}/recipes-*/*/*.bbappend"

BBFILE_COLLECTIONS += "meta-gradProject"
BBFILE_PATTERN_meta-gradProject = "^${LAYERDIR}/"
BBFILE_PRIORITY_meta-gradProject = "6"

LAYERDEPENDS_meta-gradProject = "core"
LAYERSERIES_COMPAT_meta-gradProject = "kirkstone"
```
